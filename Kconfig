## Kconfig
```kconfig
menu "WiFi Logger configuration"

choice TRANSPORT_PROTOCOL
    prompt "Network protocol (TCP/UDP/WEBSOCKET)"
    default TRANSPORT_PROTOCOL_UDP
    help
        "Network protocol to be used to relay log messages, either use UDP or TCP."

    config TRANSPORT_PROTOCOL_UDP
        bool "UDP"

    config TRANSPORT_PROTOCOL_TCP
        bool "TCP"

    config TRANSPORT_PROTOCOL_WEBSOCKET
        bool "WEBSOCKET"

endchoice

config ROUTE_ESP_IDF_API_LOGS_TO_WIFI
    bool "Route logs generated by ESP_LOGX to the wifi logger"
    default false
    help
        "Sets if logs generated by ESP-IDF logging API should be sent to remote logger"

if TRANSPORT_PROTOCOL_UDP || TRANSPORT_PROTOCOL_TCP

config SERVER_IP_ADDRESS
    string "Server IP Address"
    default "192.168.0.10"
    help 
        "IP Address of server, where logs are to be sent"
    

config SERVER_PORT
    int "Port"
    default 9999
    help 
        "Port of server, where logs are to be sent"

endif

if TRANSPORT_PROTOCOL_WEBSOCKET

config SERVER_WEBSOCKET_URI
    string "Websocket Server URI"
    default "ws://192.168.0.1:1234"
    help
        "URI of Websocket server, where logs are to be sent"

endif
        
config MESSAGE_QUEUE_SIZE
    int "Queue Size"
    default 1000
    help 
        "Sets message queue size"

config BUFFER_SIZE
    int "logger buffer size"
    default 512
    help 
        "Logger buffer size"
        
endmenu
```
